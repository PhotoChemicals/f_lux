#include <SPI.h>
#include <Wire.h>
#include <Adafruit_GFX.h>
#include <Adafruit_SSD1306.h>
#include <ClickEncoder.h>
#include <TimerOne.h>
#include <Adafruit_Sensor.h>
#include "Adafruit_TSL2591.h"
#include <EEPROM.h>
#include <avr/pgmspace.h>
#include "LowPower.h"

#define OLED_RESET 4
Adafruit_SSD1306 display(OLED_RESET);

int16_t theClick, held, timesAround;

ClickEncoder *encoder;
int16_t rawValue, debounceEncoder; //, last;

void timerIsr() {
  encoder->service();
}

static const unsigned char PROGMEM boot_frame_1[] =
{ 0xFF, 0xFF, 0xCF, 0xFF, 0xFF, 0xFF, 0xFF, 0xFF, 0xCF, 0xFF, 0xFF, 0xFF, 0xFF, 0xFF, 0xFF, 0xFF,
  0xFF, 0xFF, 0xE7, 0xFF, 0xFF, 0xFF, 0xFF, 0xFF, 0xCF, 0xFF, 0xFF, 0xFF, 0xFF, 0xFF, 0xFF, 0xFF,
  0xFF, 0xFF, 0xF9, 0xFF, 0xFF, 0xFF, 0xFF, 0xFF, 0xCF, 0xFF, 0xFF, 0xFF, 0xFF, 0xFF, 0xFF, 0xFF,
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  0xFF, 0xFF, 0xFF, 0xFF, 0xFF, 0xFF, 0xFF, 0xF7, 0xFF, 0xFF, 0xFF, 0xFF, 0xFF, 0xFC, 0x7F, 0xFF
};

static const unsigned char PROGMEM boot_frame_2[] =
{ 0xFF, 0xFF, 0xFF, 0xFF, 0xE3, 0xFF, 0xFF, 0xFF, 0xFF, 0xFB, 0xFF, 0xFF, 0xFF, 0xFF, 0xFF, 0xFF,
  0xFF, 0xFF, 0xFF, 0xFF, 0xF8, 0xFF, 0xFF, 0xFF, 0xFF, 0xFB, 0xFF, 0xFF, 0xFF, 0xFF, 0xFF, 0xFF,
  0xFF, 0xFF, 0xFF, 0xFF, 0xFE, 0x3F, 0xFF, 0xFF, 0xFF, 0xFB, 0xFF, 0xFF, 0xFF, 0xFF, 0xFF, 0xFF,
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  0xFF, 0xFF, 0xFF, 0xFF, 0xFF, 0xFF, 0xDF, 0xFF, 0xFF, 0xFF, 0xFF, 0xFF, 0x1F, 0xFF, 0xFF, 0xFF
};

static const unsigned char PROGMEM boot_frame_3[] =
{ 0xFF, 0xFF, 0xFF, 0xFF, 0xFF, 0xFF, 0xFF, 0xF0, 0x01, 0xFF, 0xFF, 0xFE, 0xFF, 0xFF, 0xFF, 0xFF,
  0xFF, 0xFF, 0xFF, 0xFF, 0xFF, 0xFF, 0xFF, 0xC0, 0x00, 0x7F, 0xFF, 0xFE, 0xFF, 0xFF, 0xFF, 0xFF,
  0xFF, 0xFF, 0xFF, 0xFF, 0xFF, 0xFF, 0xFF, 0x00, 0x00, 0x1F, 0xFF, 0xFE, 0xFF, 0xFF, 0xFF, 0xFF,
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  0xFF, 0xFF, 0xFF, 0xFF, 0xEF, 0xFF, 0xFF, 0xFF, 0x0F, 0xFF, 0xFF, 0xFF, 0xFF, 0xFF, 0xFF, 0xFF
};

static const unsigned char PROGMEM boot_frame_4[] =
{ 0xFF, 0xFF, 0xFF, 0xF0, 0x00, 0x00, 0x00, 0x00, 0x00, 0x00, 0x00, 0x00, 0x03, 0xFD, 0xFF, 0xFF,
  0xFF, 0xFF, 0xFF, 0xC0, 0x00, 0x00, 0x00, 0x00, 0x00, 0x00, 0x00, 0x00, 0x00, 0xFD, 0xFF, 0xFF,
  0xFF, 0xFF, 0xFF, 0x00, 0x00, 0x00, 0x00, 0x00, 0x00, 0x00, 0x00, 0x00, 0x00, 0x3D, 0xFF, 0xFF,
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  0xFF, 0xFF, 0xEF, 0xFF, 0x80, 0x00, 0x00, 0x00, 0x00, 0x00, 0x00, 0x00, 0x7F, 0xFF, 0xFF, 0xFF
};

static const unsigned char PROGMEM boot_frame_5[] =
{ 0x00, 0x00, 0x00, 0x00, 0x00, 0x00, 0x00, 0x00, 0x00, 0x00, 0x00, 0x00, 0x00, 0x00, 0x00, 0x00,
  0x00, 0x00, 0x00, 0x00, 0x00, 0x00, 0x00, 0x00, 0x00, 0x00, 0x00, 0x00, 0x00, 0x00, 0x00, 0x00,
  0x00, 0x00, 0x00, 0x00, 0x00, 0x00, 0x00, 0x00, 0x00, 0x00, 0x00, 0x00, 0x00, 0x00, 0x00, 0x00,
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  0x00, 0x00, 0x00, 0x00, 0x00, 0x00, 0x00, 0x00, 0x00, 0x00, 0x00, 0x00, 0x00, 0x00, 0x00, 0x00
};

static const unsigned char PROGMEM battery_full [] =
{ 0x7F, 0xE0, 0x40, 0x20, 0x5F, 0xB8, 0x5F, 0xB8, 0x5F, 0xB8, 0x5F, 0xB8, 0x40, 0x20, 0x7F, 0xE0 };

static const unsigned char PROGMEM battery_threequarters [] =
{ 0x7F, 0xE0, 0x40, 0x20, 0x5C, 0x38, 0x5E, 0x38, 0x5E, 0x38, 0x5F, 0x38, 0x40, 0x20, 0x7F, 0xE0 };

static const unsigned char PROGMEM battery_half [] =
{ 0x7F, 0xE0, 0x40, 0x20, 0x58, 0x38, 0x58, 0x38, 0x5C, 0x38, 0x5C, 0x38, 0x40, 0x20, 0x7F, 0xE0 };

static const unsigned char PROGMEM battery_low [] =
{ 0x7F, 0xE0, 0x40, 0x20, 0x50, 0x38, 0x50, 0x38, 0x50, 0x38, 0x50, 0x38, 0x40, 0x20, 0x7F, 0xE0 };

static const unsigned char PROGMEM battery_empty [] =
{ 0x7F, 0xE0, 0x40, 0x20, 0x40, 0x38, 0x40, 0x38, 0x40, 0x38, 0x40, 0x38, 0x40, 0x20, 0x7F, 0xE0 };

static const unsigned char PROGMEM settings_gear [] =
{ 0x00, 0x00, 0x00, 0x00, 0x00, 0x00, 0x00, 0xE0, 0x05, 0xB4, 0x0F, 0x1E, 0x04, 0x04, 0x0C, 0x06,
  0x18, 0xE3, 0x10, 0xA1, 0x18, 0xE3, 0x0C, 0x06, 0x04, 0x04, 0x0F, 0x1E, 0x05, 0xB4, 0x00, 0xE0
};

static const unsigned char PROGMEM f_stop_graphic [] =
{ 0x01, 0xC0, 0x00, 0x01, 0xC0, 0x03, 0x0E, 0x00, 0x03, 0x0E, 0x00, 0x06, 0x0E, 0x00, 0x06, 0x0E,
  0x00, 0x06, 0x0E, 0x00, 0x0C, 0x0E, 0x00, 0x0C, 0x7F, 0xC0, 0x0C, 0x7F, 0xC0, 0x18, 0x7F, 0xC0,
  0x18, 0x0E, 0x00, 0x38, 0x0E, 0x00, 0x30, 0x0E, 0x00, 0x30, 0x0E, 0x00, 0x70, 0x0E, 0x00, 0x60,
  0x0E, 0x00, 0x60, 0x0E, 0x00, 0xE0, 0x0E, 0x00, 0xC0, 0x0E, 0x00, 0xC0, 0x0E, 0x01, 0x80, 0x0E,
  0x01, 0x80, 0x70, 0x01, 0x80, 0x70, 0x00, 0x00
};


Adafruit_TSL2591 tsl = Adafruit_TSL2591(2591);

float fStop = 0;
char fStopStandard[] = "2.8";
byte fstopPicker=0;
float theRemainder = 0;
byte byteRemainder = 0;
int filmspeedSelector = 6;
int filmspeedDigits = 100;
const unsigned int PROGMEM filmspeedArray[] = {
  1, 5, 10, 25, 50, 100, 200, 400, 500, 600, 800, 1200, 1600, 3200, 6400 
};
int shutterspeedDigits = 0;
int shutterspeedSelector = 10;
const unsigned int PROGMEM shutterspeedArray[] = {
  3000, 2000, 1500, 1000, 800, 500, 400, 250, 200, 125, 100, 50, 25, 10, 8, 5, 4, 2, // 18 Fraction of a second
  1, 2, 3, 4, 5, 8, 10, 15, 20, 30, 45, // 16 Over a second
  1, 2, 3, 4, 5, 10, 15, 20, 30, 45, 60, // Over a minute
  1, 2, 4, 8, 12, 16, 18, 24, 25, 36, 48, 50, 64, 72, 128, 256, 300 // 17 fps
};

float thelux = 0;
float filmSpeed = 200;
float shutterSpeed = 100;
long poweroffTimer = 0;
long battTimer = 0;
long encoderTimer = 0;
byte setupMode = 0;
byte x = 0;
boolean setupDisplay = false;
boolean sensorTrigger = true;
byte meterSensitivity = 1;
byte gainAmount = 1;
boolean batteryInfo = false;
byte displayMode = 1;
byte setupmenuSelector = 1;
byte powersaveSelector = 2;
unsigned int voltage = 0;
unsigned int powersaveAmount = 20000;
bool justturnedOn = false;
const unsigned int PROGMEM powersaveArray[] = {
  5,10,15,20,30,45,60,90,180,4294967
};

//const char* PROGMEM fstopStandardArray[] = {"1","1.4","2","2.8","4","5.6","8","11","16","22","32","64","90"};
const char fstoparray_1[] PROGMEM = "1";
const char fstoparray_2[] PROGMEM = "1.4";
const char fstoparray_3[] PROGMEM = "2";
const char fstoparray_4[] PROGMEM = "2.8";
const char fstoparray_5[] PROGMEM = "4";
const char fstoparray_6[] PROGMEM = "5.6";
const char fstoparray_7[] PROGMEM = "8";
const char fstoparray_8[] PROGMEM = "11";
const char fstoparray_9[] PROGMEM = "16";
const char fstoparray_10[] PROGMEM = "22";
const char fstoparray_11[] PROGMEM = "32";
const char fstoparray_12[] PROGMEM = "64";
const char fstoparray_13[] PROGMEM = "90";
const char * const fstopStandardArray[] PROGMEM = 
{fstoparray_1,fstoparray_2,fstoparray_3,fstoparray_4,fstoparray_5,fstoparray_6,fstoparray_7,fstoparray_8,fstoparray_9,fstoparray_10,fstoparray_11,fstoparray_12,fstoparray_13};
char buffer[30];

void configureSensor(void)
{
  if (gainAmount == 1) {
    tsl.setGain(TSL2591_GAIN_LOW);    // 1x gain (bright light)
  } else if (gainAmount == 2) {
    tsl.setGain(TSL2591_GAIN_MED);      // 25x gain
  } else if (gainAmount == 3) {
    tsl.setGain(TSL2591_GAIN_HIGH);   // 428x gain
  } else if (gainAmount == 4) {
    tsl.setGain(TSL2591_GAIN_MAX);   // 9876x gain
  }

  // Changing the integration time gives you better sensor resolution (402ms = 16-bit data)
  if (meterSensitivity == 3) {
    tsl.setTiming(TSL2591_INTEGRATIONTIME_600MS);  // 16-bit data but slowest conversions
  } else if (meterSensitivity == 2) {
    tsl.setTiming(TSL2591_INTEGRATIONTIME_400MS);  // medium resolution and speed
  } else {
    tsl.setTiming(TSL2591_INTEGRATIONTIME_100MS);  // shortest integration time (bright light)
  }
}

void eepromWriteSpeeds () {
  EEPROM.update(5, filmspeedSelector);
  EEPROM.update(6, shutterspeedSelector);
}

void eepromWriteSettings () {
  EEPROM.update(1, displayMode);
  EEPROM.update(2, meterSensitivity);
  EEPROM.update(3, powersaveSelector);
  EEPROM.update(4, batteryInfo);
}

void eepromDefaults () {
  displayMode = EEPROM.read(1);
  meterSensitivity  = EEPROM.read(2);
  powersaveSelector = EEPROM.read(3);
  batteryInfo = EEPROM.read(4);
  filmspeedSelector = EEPROM.read(5);
  shutterspeedSelector = EEPROM.read(6);
}

void setup()   {
  pinMode(3, INPUT_PULLUP); // Rotatry encoder click
  pinMode(10, OUTPUT); // OLED trigger -> transistor Base
  digitalWrite(10, HIGH);
  delay(100);

  display.begin(SSD1306_SWITCHCAPVCC, 0x3C);  // initialize with the I2C addr 0x3D (for the 128x64)  
  display.clearDisplay();
  display.drawBitmap(0, 0, boot_frame_1, 128, 64, 1);
  display.display();
  display.clearDisplay();
  display.drawBitmap(0, 0, boot_frame_2, 128, 64, 1);
  display.display();
  display.clearDisplay();
  display.drawBitmap(0, 0, boot_frame_3, 128, 64, 1);
  display.display();
  display.clearDisplay();
  display.drawBitmap(0, 0, boot_frame_4, 128, 64, 1);
  display.display();
  display.clearDisplay();
  display.drawBitmap(0, 0, boot_frame_5, 128, 64, 1);
  display.display();
  delay(250);
  display.setTextColor(WHITE);

  encoder = new ClickEncoder(A1, A0, 3, 4);
  encoder->setAccelerationEnabled(false);
  Timer1.initialize(1000);
  Timer1.attachInterrupt(timerIsr);

  eepromDefaults(); // Read defaults from EEPROM
  configureSensor();
  delay(10);
  powersaveAmount = (pgm_read_word_near(powersaveArray + powersaveSelector))*1000;
  readVcc();
  lightSensor();
  sensorTrigger = true;
  poweroffTimer = millis();
}

void readVcc() {
  // Read 1.1V reference against AVcc
  // set the reference to Vcc and the measurement to the internal 1.1V reference
#if defined(__AVR_ATmega32U4__) || defined(__AVR_ATmega1280__) || defined(__AVR_ATmega2560__)
  ADMUX = _BV(REFS0) | _BV(MUX4) | _BV(MUX3) | _BV(MUX2) | _BV(MUX1);
#elif defined (__AVR_ATtiny24__) || defined(__AVR_ATtiny44__) || defined(__AVR_ATtiny84__)
  ADMUX = _BV(MUX5) | _BV(MUX0);
#elif defined (__AVR_ATtiny25__) || defined(__AVR_ATtiny45__) || defined(__AVR_ATtiny85__)
  ADMUX = _BV(MUX3) | _BV(MUX2);
#else
  ADMUX = _BV(REFS0) | _BV(MUX3) | _BV(MUX2) | _BV(MUX1);
#endif

  delay(1); // Wait for Vref to settle
  ADCSRA |= _BV(ADSC); // Start conversion
  while (bit_is_set(ADCSRA, ADSC)); // measuring

  uint8_t low  = ADCL; // must read ADCL first - it then locks ADCH
  uint8_t high = ADCH; // unlocks both

  voltage = (high << 8) | low;
  voltage = 1125300L / voltage; // Calculate Vcc (in mV); 1125300 = 1.1*1023*1000
}

void printVcc() {  
  if (voltage != 0) {
    if (batteryInfo){
      display.print(voltage);
    }
  
    if (voltage >= 4050) {
      display.drawBitmap(115, 0, battery_full, 16, 8, 1);
    } else if (voltage >= 3800 && voltage < 4050) {
      display.drawBitmap(115, 0, battery_threequarters, 16, 8, 1);
    } else if (voltage >= 3500 && voltage < 3800) {
      display.drawBitmap(115, 0, battery_half, 16, 8, 1);
    } else if (voltage >= 3100 && voltage < 3500) {
      display.drawBitmap(115, 0, battery_low, 16, 8, 1);
    } else if (voltage >= 2900 && voltage < 3100) {
      display.drawBitmap(115, 0, battery_empty, 16, 8, 1);
    } else if (voltage >= 2800 && voltage < 3000 && x<3) {
      display.drawBitmap(115, 0, battery_empty, 16, 8, 1);
    } else if (voltage >= 2700 && voltage < 2800 && x<2) {
      display.drawBitmap(115, 0, battery_empty, 16, 8, 1);
    } else if (x==1) {
      display.drawBitmap(115, 0, battery_empty, 16, 8, 1);
    }
  }
}

void lightSensor () {
//  configureSensor();
  uint32_t lum = tsl.getFullLuminosity();
  uint16_t ir, full;
  ir = lum >> 16; 
  full = lum & 0xFFFF;
  thelux = tsl.calculateLux(full, ir);
  thelux *= 4.25;  // x4.25 for Calbration
}

void sensorCompute () {
  if (shutterspeedSelector > 56) {
    shutterspeedSelector = 0;
  } else if (shutterspeedSelector < 0) {
    shutterspeedSelector = 56;
  }
  
  if (filmspeedSelector > 14) {
    filmspeedSelector = 0;
  } else if (filmspeedSelector < 0) {
    filmspeedSelector = 14;
  }
  
  shutterspeedDigits = pgm_read_word_near(shutterspeedArray + shutterspeedSelector);
  
  if (shutterspeedSelector <= 17) {
    shutterSpeed = (1 / (float)shutterspeedDigits);
  } else if (shutterspeedSelector >= 18 && shutterspeedSelector <= 28) {
    shutterSpeed = (float)shutterspeedDigits;
  } else if (shutterspeedSelector >= 29 && shutterspeedSelector <= 39) {
    shutterSpeed = (60*(float)shutterspeedDigits);
  } else if (shutterspeedSelector >= 40 && shutterspeedSelector <= 56) {
    shutterSpeed =  ( 1 / (2 * (float)shutterspeedDigits) );
  }

  filmspeedDigits = pgm_read_word_near(filmspeedArray + filmspeedSelector);
  filmSpeed = float(filmspeedDigits);
  
  float theNumerator = (0.0929) * (thelux) * (filmSpeed) * (shutterSpeed);
  fStop = sqrt(theNumerator / 25);
//  fStop = sqrt((thelux*filmSpeed/(14))*shutterSpeed);
  
  if (displayMode==2) {
    fstopDisplay();
  }
}

void fstopDisplay() {
    if ((fStop >= 1) && (fStop < 1.4)) {
      theRemainder = (1.4 - fStop);
      fstopPicker = 0;
    } else if ((fStop >= 1.4) && (fStop < 2)) {
      theRemainder = ((2 - fStop)/.6);
      fstopPicker = 1;
    } else if ((fStop >= 2) && (fStop < 2.8)) {
      theRemainder = ((2.8 - fStop)/.8);
      fstopPicker = 2;
    } else if ((fStop >= 2.8) && (fStop < 4)) {
      theRemainder = ((4 - fStop)/1.2);
      fstopPicker = 3;
    } else if ((fStop >= 4) && (fStop < 5.6)) {
      theRemainder = ((5.6 - fStop)/1.6);
      fstopPicker = 4;
    } else if ((fStop >= 5.6) && (fStop < 8)) {
      theRemainder = ((8 - fStop)/2.4);
      fstopPicker = 5;
    } else if ((fStop >= 8) && (fStop < 11)) {
      theRemainder = ((11 - fStop)/3);
      fstopPicker = 6;
    } else if ((fStop >= 11) && (fStop < 16)) {
      theRemainder = ((16 - fStop)/5);
      fstopPicker = 7;
    } else if ((fStop >= 16) && (fStop < 22)) {
      theRemainder = ((22 - fStop)/6);
      fstopPicker = 8;
    } else if ((fStop >= 22) && (fStop < 32)) {
      theRemainder = ((32 - fStop)/10);
      fstopPicker = 9;
    } else if ((fStop >= 32) && (fStop < 64)) {
      theRemainder = ((64 - fStop)/32);
      fstopPicker = 10;
    } else if ((fStop >= 64) && (fStop < 90)) {
      theRemainder = ((90 - fStop)/64);
      fstopPicker = 11;
    } else if ((fStop >= 90) && (fStop < 100)) {
      theRemainder = ((128 - fStop)/90);
      fstopPicker = 12;
    } else {
      fstopPicker = 0;
    }
    theRemainder*=10;
    byteRemainder=(10-byte(theRemainder+.5));
    if (byteRemainder==10) {
      byteRemainder=0;
      fstopPicker +=1;
    }    

    strcpy_P(fStopStandard, (char*)pgm_read_word(&(fstopStandardArray[fstopPicker])));
}

void shutterspeedDisplay () {
  if (shutterspeedSelector <= 17) {
    display.print(F("1/"));
    display.print(shutterspeedDigits);
  } else if (shutterspeedSelector == 18) {
    display.print(shutterspeedDigits);
    display.print(F(" sec"));
  } else if (shutterspeedSelector >= 19 && shutterspeedSelector <= 28) {
    display.print(shutterspeedDigits);
    display.print(F(" secs"));
    } else if (shutterspeedSelector == 29) {
    display.print(shutterspeedDigits);
    display.print(F(" min"));
  } else if (shutterspeedSelector >= 30 && shutterspeedSelector <= 39) {
    display.print(shutterspeedDigits);
    display.print(F(" mins"));
  } else if (shutterspeedSelector >= 40 && shutterspeedSelector <= 56) {
    display.print(shutterspeedDigits);
    display.print(F(" fps"));
  }
}

void setupMenu() {
  if (setupmenuSelector < 1) {
    setupmenuSelector = 6;
  } else if (setupmenuSelector > 6) {
    setupmenuSelector = 1;
  }
  
  display.setTextSize(2);
  display.setCursor(13, 0);
  display.print(F("Setup"));
  display.setTextSize(1);
  if (setupmenuSelector <= 4) {  // Display Page 1
    display.setCursor(0, 16);
    display.print(F("Display: "));
    if (setupmenuSelector==1 && x > 2) {   
    } else {
      if (displayMode==1) {
        display.print(F("Precise"));
      } else if (displayMode==2) {
        display.print(F("Standard"));
      } else if (displayMode==3) {
        display.print(F("Lux"));
      }
    }
    display.setCursor(0, 26);
    display.print(F("Polling: "));
    if (setupmenuSelector==2 && x > 2) {   
    } else {
      if (meterSensitivity==1) {
        display.print(F("Fast (LQ)"));
      } else if (meterSensitivity==2) {
        display.print(F("Medium"));
      } else if (meterSensitivity==3) {
        display.print(F("Slow (HQ)"));
      }
    }
    display.setCursor(0, 36);
    display.print(F("Gain: "));
    if (setupmenuSelector==3 && x > 2) {   
    } else {
      if (gainAmount==1) {
        display.print(F("Low"));
      } else if (gainAmount==2) {
        display.print(F("Medium"));
      } else if (gainAmount==3) {
        display.print(F("High"));
      } else if (gainAmount==4) {
        display.print(F("Max"));
      }
    }
    display.setCursor(0, 46);
    display.print(F("Sleep: "));
    if ( (setupmenuSelector==4) && (x > 2) ) {     
    } else {
      if (powersaveSelector == 9 ) {
        display.print(F("Off (CAUTION)"));
      } else {
        display.print((pgm_read_word_near(powersaveArray + powersaveSelector)));
        display.print(F(" secs"));
      }
    }
  } else {  // Display Page 2
    display.setCursor(0, 16);
    display.print(F("Battery Info: "));
    if (setupmenuSelector==5 && x > 2) {     
    } else {
      if (batteryInfo) {
        display.print(F("On"));
      } else {
        display.print(F("Off"));
      }
    }
  }
    
  display.setCursor(0, 56);
  
  if (setupmenuSelector == 6 && x > 2) {
    display.print(F("[    ]"));
  } else {
    display.print(F("[Exit]"));
  }
}

void displayStuff() {
  display.clearDisplay();
  if (!setupDisplay) {
    if (sensorTrigger) {
      sensorTrigger=false;
      sensorCompute();
    }
    display.setTextSize(3);
    if ((displayMode==1) && (fStop < 10)) {
      display.drawBitmap(25, 16, f_stop_graphic, 24, 24, 1);
      display.setCursor(55, 16);
      display.print(fStop, 1);
    } else if ((displayMode==1) && (fStop < 100)) {
      display.drawBitmap(17, 16, f_stop_graphic, 24, 24, 1);
      display.setCursor(47, 16);
      display.print(fStop, 1);
    } else if ((displayMode == 1 || displayMode == 2) && fStop >= 100) {
//      if (millis >= 3000) {
//        display.setCursor(25, 16);
//        display.print(F("Error"));
//      }
      lightSensor();
      sensorTrigger = true;
//      delay(100);
    } else if (displayMode == 2 && fStop < 1) {
      display.drawBitmap(25, 16, f_stop_graphic, 24, 24, 1);
      display.setCursor(55, 16);
      display.print(fStop, 1);
    } else if ((displayMode == 2) && (fStop < 64) && (fstopPicker == 1 || fstopPicker == 3 || fstopPicker == 5)) {
      display.drawBitmap(20, 16, f_stop_graphic, 24, 24, 1);
      display.setCursor(50, 16);
      display.print(fStopStandard);
      display.setCursor(110, 29);
      display.setTextSize(1);
      display.print(byteRemainder);
    } else if (displayMode == 2 && fstopPicker < 7) {
      display.drawBitmap(37, 16, f_stop_graphic, 24, 24, 1);
      display.setCursor(67, 16);
      display.print(fStopStandard);
      display.setCursor(90, 29);
      display.setTextSize(1);
      display.print(byteRemainder);
    } else if (displayMode == 2 && fStop < 100) {
      display.drawBitmap(30, 16, f_stop_graphic, 24, 24, 1);
      display.setCursor(60, 16);
      display.print(fStopStandard);
      display.setCursor(102, 29);
      display.setTextSize(1);
      display.print(byteRemainder);
    } else if (displayMode == 3) {
      display.setCursor(10, 16);
      if (thelux < 10) {
        display.setCursor(28, 16);
        display.print(thelux, 2);
      } else if (thelux > 10 && thelux < 1000) {
        display.print(thelux,2);
      } else if (thelux > 1000 && thelux < 10000) {
        display.print(thelux,1);
      } else {
        display.print(thelux,0);
      }
      display.setTextSize(1);
      if (thelux >= 100) {
        display.setCursor(100, 40);
      } else {
        display.setCursor(100, 30);
      }
      display.print(F(" Lux")); 
    }
    display.setTextSize(1);
    display.setCursor(0, 48);
    display.print(F("ISO: "));
    if (setupMode == 1 && x > 2) {

    } else {
      display.print((int)filmSpeed, WHITE);
    }


    display.setCursor(0, 57);
    display.print(F("Shutter: "));
    display.setCursor(52, 57);
    if (setupMode == 2 && x > 2) {

    } else {
      shutterspeedDisplay();
    }

    if (setupMode == 3 && x > 2) {
      display.drawBitmap(112, 48, settings_gear, 16, 16, 1);
    } else {

    }
  } else {
    setupMenu();
  }

  display.setCursor(90, 0);
  printVcc();
  display.display();
}

void wakeUp() {
  
}

void loop() {
  rawValue = encoder->getValue();
  debounceEncoder += abs(rawValue);

  if (debounceEncoder >= 2) {
    debounceEncoder=0;
  } else {
    rawValue = 0;
  }
  
  if (rawValue == 1) {
    debounceEncoder += 1;
  }
  
  if (rawValue != 0) { // && (setupMode > 0) ) {
    if (setupMode == 1) {
      x = 9;
    }
    if ((setupMode == 1) && (!setupDisplay)) {
      filmspeedSelector += rawValue;
    } else if (setupMode == 2 && !setupDisplay) {
      shutterspeedSelector += rawValue;
    } else if (setupDisplay) {
      setupmenuSelector += rawValue;
    }
    poweroffTimer = millis();
    debounceEncoder=0;
    sensorTrigger = true;
  }

  ClickEncoder::Button b = encoder->getButton();
  if (b != ClickEncoder::Open) {
    switch (b) {
      case ClickEncoder::Pressed:
        break;
      case ClickEncoder::Held:
        lightSensor();
        sensorTrigger = true;
        poweroffTimer = millis();
        debounceEncoder=0;
        break;
      case ClickEncoder::Released:
        break;
      case ClickEncoder::Clicked:
        if (setupDisplay && setupmenuSelector == 1) {
          if (displayMode == 3) {
            displayMode = 1;
          } else {
            displayMode +=1;
          }
        } else if (setupDisplay && setupmenuSelector == 2) {
          if (meterSensitivity>=3) {
            meterSensitivity=1; 
          } else {
            meterSensitivity += 1;
          }
          configureSensor();
          delay(10);
        } else if (setupDisplay && setupmenuSelector == 3) {
          if (gainAmount>=3) {
            gainAmount=1; 
          } else {
            gainAmount += 1;
          }
          configureSensor();
          delay(10);
        } else if (setupDisplay && setupmenuSelector == 4) {
          powersaveSelector += 1;
          if (powersaveSelector > 9) {
            powersaveSelector = 0;
          }
          powersaveAmount = (pgm_read_word_near(powersaveArray + powersaveSelector))*1000;
        } else if (setupDisplay && setupmenuSelector == 5) {
          batteryInfo = !batteryInfo;
        } else if (setupDisplay && setupmenuSelector == 6 ) { // exit
          eepromWriteSettings(); // write settings to EEPROM
          setupMode = 0;
          setupDisplay = false;
        }
        
        if (setupMode != 3 && !setupDisplay && !justturnedOn) {
          lightSensor();
          sensorTrigger = true;
          eepromWriteSpeeds();
        } else if (setupMode != 3 && !setupDisplay && justturnedOn) {
          justturnedOn = false;
        } else if (setupMode == 3 && !setupDisplay) {
          setupmenuSelector=1;
          setupDisplay = true;
        }
         
        poweroffTimer = millis();
        debounceEncoder=0;
//        sensorTrigger = true;
        break;
      case ClickEncoder::DoubleClicked:
        if (!setupDisplay) {
          setupMode += 1;
          if (setupMode > 3) {
            setupMode = 0;
          }
        }
        poweroffTimer = millis();
        debounceEncoder=0;
        sensorTrigger = true;
        break;
    }
  }
  long currentTime = millis();
  if ( (currentTime >= (poweroffTimer + powersaveAmount)) && (powersaveSelector != 9) ) {
    digitalWrite(10, LOW);
    eepromWriteSpeeds(); // write ISO and shutter speeds to EEPROM
    delay(100);
    attachInterrupt(1, wakeUp, FALLING);
    LowPower.powerDown(SLEEP_FOREVER, ADC_OFF, BOD_OFF); 
    detachInterrupt(1); 
    digitalWrite(10, HIGH);
    delay(100);
    readVcc();
    configureSensor();
    delay(10);
    display.begin(SSD1306_SWITCHCAPVCC, 0x3C);
    poweroffTimer = millis();
    debounceEncoder=0;
    justturnedOn = true;
  }
  
  if (currentTime >= battTimer + 1000) {
   battTimer = millis();
   readVcc(); 
  }

  displayStuff();

  if (x < 5) {
    x += 1;
  } else {
    x = 0;
  }
}
